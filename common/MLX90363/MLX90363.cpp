#include "MLX90363.h"
#include <SPI.h>

#define MELEXIS_GET1 0x13
#define MELEXIS_GET2 0x14
#define MELEXIS_GET3 0x15
#define MELEXIS_MemoryRead 0x01
#define MELEXIS_EEPROMWrite 0x03
#define MELEXIS_EEChallengeAns 0x05
#define MELEXIS_EEReadChallenge 0x0F
#define MELEXIS_NOP 0x10
#define MELEXIS_DiagnosticDetails 0x16
#define MELEXIS_OscCounterStart 0x18
#define MELEXIS_OscCounterStop 0x1A
#define MELEXIS_Reboot 0x2F
#define MELEXIS_Standby 0x31

SPISettings settingsMLX(1000000, MSBFIRST, SPI_MODE1); 

const char cba_256_TAB [] = {0x00, 0x2f, 0x5e, 0x71, 0xbc, 0x93, 0xe2, 0xcd,
							0x57, 0x78, 0x09, 0x26, 0xeb, 0xc4, 0xb5, 0x9a,
							0xae, 0x81, 0xf0, 0xdf, 0x12, 0x3d, 0x4c, 0x63,
							0xf9, 0xd6, 0xa7, 0x88, 0x45, 0x6a, 0x1b, 0x34,
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							0x8f, 0xa0, 0xd1, 0xfe, 0x33, 0x1c, 0x6d, 0x42};

MLX90363::MLX90363(uint8_t sspin) : slave_select(sspin)
{
	SPI.begin(); 
    pinMode (slave_select, OUTPUT);
    digitalWrite(slave_select,HIGH);
    zero_position = 0;
    summed_value = 0;
    raw_value = 0;

}

void MLX90363::InitializeSPI(int mosi, int miso, int sck)
{
    pinMode(mosi, OUTPUT); 
    pinMode(sck, OUTPUT); 
    pinMode(miso, OUTPUT); 
    SPI.setMOSI(mosi);  //11
    SPI.setSCK(sck);    //13
    SPI.setMISO(miso);  //12
    SPI.begin();
}

void MLX90363::SetZeroPosition(int16_t offset)
{
    zero_position = offset;
    summed_value = -zero_position;
}

bool MLX90363::SendGET3()
{
    memset(&send_buffer,0,sizeof(uint8_t)*8);
    send_buffer[2] = 0xFF;
    send_buffer[3] = 0xFF;
	  send_buffer[6] = 0x00 | MELEXIS_GET3;   // alpha-diganostic
	send_buffer[7] = 0x08;
    return SendSPI();
}

bool MLX90363::SendNOP()
{
    memset(&send_buffer,0,sizeof(uint8_t)*8);
    send_buffer[2] = 0xFF;
    send_buffer[3] = 0xFF;
    send_buffer[6] = 0xC0 | MELEXIS_NOP;
	send_buffer[7] = 0xAB;
    return SendSPI();
}

bool MLX90363::SendSPI()
{
    Checksum(send_buffer);
	SPI.beginTransaction(settingsMLX);
    digitalWrite(slave_select,LOW);
    delayMicroseconds(1);
    for (i=0; i<8; i++)
      receive_buffer[i] = SPI.transfer(send_buffer[i]);
    delayMicroseconds(1);
    digitalWrite(slave_select,HIGH);
	SPI.endTransaction();
    return Checksum(receive_buffer);
}

bool MLX90363::Checksum(uint8_t *message)
{
    crc = message[7];
    message[7] = 0xFF;
    for (j=0; j<7; j++)
        message[7] = cba_256_TAB[ message[j] ^ message[7] ];
    message[7] = ~message[7];
    if ((receive_buffer[2]|receive_buffer[3]|receive_buffer[5])!=0x00){
    	// a different message has been recieved
    	return true;
    }
    if ((receive_buffer[6] >>6)!= 0x00){
    // the message is not and apla message.
    	return true;
    }
    return !(message[7]==crc);// returning true means there is an error.
}

int64_t MLX90363::ReadAngle()
{
    const static int16_t OVERFLOW_EPSILON = 100;
    // Previous value
    const int16_t prev_value = raw_value;

    // A 14-bit value is read from the sensor.
    raw_value = (int16_t)(
        receive_buffer[0] | ((receive_buffer[1]&0x3F)<<8)
    ); 
    raw_value = raw_value - zero_position;
    if (raw_value >= 8191)
      raw_value -= 16384;
    if (raw_value <= -8192)
      raw_value += 16384;

    // if (prev_value > 0x4000 - OVERFLOW_EPSILON && raw_value < OVERFLOW_EPSILON)
    // {
    //     summed_value += (0x4000 - prev_value) + raw_value;
    // }
    // else if (prev_value < OVERFLOW_EPSILON && raw_value > 0x4000 - OVERFLOW_EPSILON)
    // {
    //     summed_value += prev_value + (0x4000 - raw_value);
    // }
    // else
    // {
    //     summed_value += raw_value - prev_value;
    // }

    return raw_value;
}

void MLX90363::PrintReceiveBuffer()
{
  for (i=0; i<8; i++) {
    Serial.printf("Byte %d: 0x%02x\n",i,receive_buffer[i]);
  }
}

double MLX90363::WholeMessage()
{
double wholemessage = 0;
for (i=0; i<8; i++) {
    wholemessage = wholemessage+(int64_t)(receive_buffer[i]<<(8*i));
  }
return wholemessage;
}
